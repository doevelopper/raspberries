## br2-rpis-external/Config.in
```kconfig
# Uncomment this when you add your own packages, replacing PACKAGENAME with the name of the package folder.

#source "$BR2_EXTERNAL_RPIS_PATH/package/python_pypi/Config.in"
#source "$BR2_EXTERNAL_RPIS_PATH/package/python_local/Config.in"

menu "RPIS packages"
    menu "Template packages"
        comment "Template Cmake,Makefile and autotools packages"
        source "$BR2_EXTERNAL_RPIS_PATH/packages/applications/hellos/hello-autotools/Config.in"
        source "$BR2_EXTERNAL_RPIS_PATH/packages/applications/hellos/hello-cmake/Config.in"
        source "$BR2_EXTERNAL_RPIS_PATH/packages/applications/hellos/hello-makefile/Config.in"
        source "$BR2_EXTERNAL_RPIS_PATH/packages/applications/hellos/hello-i2c/Config.in"
        source "$BR2_EXTERNAL_RPIS_PATH/packages/applications/hellos/hello-gps/Config.in"
        source "$BR2_EXTERNAL_RPIS_PATH/packages/applications/hellos/hello-raylib/Config.in"
    endmenu

    source "$BR2_EXTERNAL_RPIS_PATH/packages/Config.in"
endmenu


source "$BR2_EXTERNAL_RPIS_PATH/packages/Config.in.host"
```

## br2-rpis-external/packages/Config.in
```kconfig
# # menu "Interpreter languages and scripting"
# # 	source "$BR2_EXTERNAL_RPIS_PATH/packages/chibi-scheme/Config.in"
# # 	source "$BR2_EXTERNAL_RPIS_PATH/packages/chicken/Config.in"
# # endmenu

# menu "Libraries"

# # menu "Crypto"
# # 	source "$BR2_EXTERNAL_RPIS_PATH/packages/bearssl/Config.in"
# # endmenu


# menu "Hello Packages"
# 	source "$BR2_EXTERNAL_RPIS_PATH/packages/hello-i2c/Config.in"
# endmenu

# endmenu

# # if BR2_PACKAGE_PYTHON || BR2_PACKAGE_PYTHON3
# # menu "External python modules"
# # 	source "$BR2_EXTERNAL_RPIS_PATH/packages/python-scapy/Config.in"
# # endmenu
# # endif


# config BR2_CFSOS_DEVEL_BUILD
# 	bool
# 	option env="BR2_CFSOS_DEVEL_BUILD"
# 	help
# 		Developers at Laird can access the closed source repositories,
# 		so they should set this flag to directly build from the closed
# 		source repositories under $BR2_EXTERNAL_CFSOS_CLOSED_SOURCE_PATH/package.

# config BR2_SUMMIT_SECURE_BOOT
# 	bool "Summit Secure Boot"
# 	select BR2_TARGET_UBOOT_NEEDS_OPENSSL
# 	help
# 		This enables "traditional" (down to kernel) secure boot
# 		rootfs security provided by BR2_PACKAGE_CFSOS_ENCRYPTED_STORAGE_TOOLKIT


menu "RPIS packages playground: BSP, Drivers applications."

    menu "Packages (Upstream)"
        # source "$BR2_EXTERNAL_RPIS_PATH/package/cfsos-br/Config.in"
        # source "$BR2_EXTERNAL_RPIS_PATH/package/cfsos-br/Config.in.host"
    endmenu

    menu "3rd Party"

        menu "Monitoring tools"
            # source "$BR2_EXTERNAL_RPIS_PATH/package/utils/atop2/Config.in"
            # source "$BR2_EXTERNAL_RPIS_PATH/package/utils/btop/Config.in"
            # source "$BR2_EXTERNAL_RPIS_PATH/package/utils/netatop/Config.in"
        endmenu

        menu "Network"

        endmenu

        menu "Benchmarking"

        endmenu

    endmenu

    menu "Linux drivers"
        if BR2_LINUX_KERNEL

            menu "Kernel Space Linux Drivers"
                # source "$BR2_EXTERNAL_RPIS_PATH/package/drivers/kernel-space/foobar_module/Config.in"
                # source "$BR2_EXTERNAL_RPIS_PATH/package/drivers/kernel-space/foobar_chrdev/Config.in"
            endmenu

            menu "Users Space Linux Drivers"
            endmenu
        endif
    endmenu

    menu "Peripheral driver"
        menu "Small TFT Screen"
            # source "$BR2_EXTERNAL_RPIS_PATH/package/rpi-fbcp/Config.in"
        endmenu
        menu "Pi Hats"
            # source "$BR2_EXTERNAL_RPIS_PATH/package/recalbox-wpaf/Config.in"
        endmenu
    endmenu

    menu "Applications"

        menu "Applications"
            # source "$BR2_EXTERNAL_RPIS_PATH/package/applications/lan-gateway/Config.in"
            # source "$BR2_EXTERNAL_RPIS_PATH/package/applications/rpi-eeprom/Config.in"
        endmenu

        menu "Applications Tests "

            menu "Unit Testing"

            endmenu

            menu "Regression Unit Testing"

            endmenu

            menu "ATP"
                menu "Ruby Runtime Environment"

                endmenu
            endmenu
        endmenu

    endmenu

endmenu
```

## br2-rpis-external/packages/applications/lan-gateway/Config.in
```kconfig
config BR2_PACKAGE_LANGW
	bool "langw"
	help
		A tool to simulate a HomeMatic LAN-Gateway.

		http://homematic-forum.de/forum/viewtopic.php?f=18&t=27705
```

## br2-rpis-external/packages/applications/sysctl/Config.in
```kconfig
config BR2_PACKAGE_SYSCTL
	bool "sysctl"
        help
          Install required sysctl configuration.
```

## br2-rpis-external/packages/utils/roughtime/Config.in
```kconfig
config BR2_PACKAGE_TLSDATE
	bool "tlsdate"
	depends on BR2_USE_MMU # fork()
	depends on BR2_USE_WCHAR # ncurses wchar
	depends on BR2_TOOLCHAIN_HEADERS_AT_LEAST_3_14 # PERF_FLAG_FD_CLOEXEC
	select BR2_PACKAGE_NCURSES
	select BR2_PACKAGE_NCURSES_WCHAR
	select BR2_PACKAGE_ZLIB
	help
		tlsdate: secure parasitic rdate replacement

		tlsdate sets the local clock by securely connecting with TLS to remote
		servers and extracting the remote time out of the secure handshake. Unlike
		ntpdate, tlsdate uses TCP, for instance connecting to a remote HTTPS or TLS
		enabled service, and provides some protection against adversaries that try to
		feed you malicious time information.

	  	https://github.com/ioerror/tlsdate.git

comment "atop2 needs a toolchain w/ wchar, headers >= 3.14"
	depends on BR2_USE_MMU
	depends on !BR2_USE_WCHAR || \
		!BR2_TOOLCHAIN_HEADERS_AT_LEAST_3_14
```
